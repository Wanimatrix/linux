## Documentation/devicetree/bindings/display/msm/qcom,hdmi.yaml
```yaml
# SPDX-License-Identifier: (GPL-2.0-only OR BSD-2-Clause)
%YAML 1.2
---

$id: "http://devicetree.org/schemas/display/msm/qcom,hdmi.yaml#"
$schema: "http://devicetree.org/meta-schemas/core.yaml#"

title: Qualcomm Adreno/Snapdragon HDMI output

maintainers:
  - Rob Clark <robdclark@gmail.com>

properties:
  compatible:
    contains:
      enum:
        - qcom,hdmi-tx-8996
        - qcom,hdmi-tx-8994
        - qcom,hdmi-tx-8084
        - qcom,hdmi-tx-8974
        - qcom,hdmi-tx-8660
        - qcom,hdmi-tx-8960

  clocks:
    minItems: 1
    maxItems: 3

  clock-names:
    minItems: 1
    maxItems: 3

  reg:
    minItems: 1
    maxItems: 3
    description: Physical base address and length of the controller's registers

  reg-names:
    anyOf:
      - items:
          - const: core_physical
      - items:
          - const: core_physical
          - const: qfprom_physical
          - const: hdcp_physical

  interrupts:
    description: The interrupt signal from the hdmi block.

  power-domains:
    description: should be <&mmcc MDSS_GDSC>

  core-vdda-supply:
    description: phandle to supply regulator

  hdmi-mux-supply:
    description: phandle to mux regulator

  phys:
    description: the phandle for the HDMI PHY device

  phy-names:
    description: the name of the corresponding PHY device

  hpd-gpios:
    description: hpd pin

  qcom,hdmi-tx-mux-en-gpios:
    description: hdmi mux enable pin

  qcom,hdmi-tx-mux-sel-gpios:
    description: hdmi mux select pin

  qcom,hdmi-tx-mux-lpm-gpios:
    description: hdmi mux lpm pin

  pinctrl-0: true
  pinctrl-1: true

  pinctrl-names:
    anyOf:
      - items:
          - const: default
      - items:
          - const: default
          - const: sleep

  ports:
    type: object
    $ref: "/schemas/graph.yaml#/properties/ports"
    properties:
      port@0:
        $ref: "/schemas/graph.yaml#/$defs/port-base"
        unevaluatedProperties: false
        description: |
          Input endpoints of the controller.
        properties:
          endpoint:
            $ref: /schemas/media/video-interfaces.yaml#
            unevaluatedProperties: false
            properties:
              data-lanes:
                maxItems: 4
                minItems: 4
                items:
                  enum: [0, 1, 2, 3]

      port@1:
        $ref: "/schemas/graph.yaml#/$defs/port-base"
        unevaluatedProperties: false
        description: |
          Output endpoints of the controller.
        properties:
          endpoint:
            $ref: /schemas/media/video-interfaces.yaml#
            unevaluatedProperties: false
            properties:
              data-lanes:
                maxItems: 4
                minItems: 4
                items:
                  enum: [0, 1, 2, 3]

    required:
      - port@0
      - port@1

required:
  - compatible
  - clocks
  - clock-names
  - reg
  - reg-names
  - interrupts
  - phys
  - phy-names

additionalProperties: false
# HDMI PHY:
# Required properties:
# - compatible: Could be the following
#   * "qcom,hdmi-phy-8660"
#   * "qcom,hdmi-phy-8960"
#   * "qcom,hdmi-phy-8974"
#   * "qcom,hdmi-phy-8084"
#   * "qcom,hdmi-phy-8996"
# - #phy-cells: Number of cells in a PHY specifier; Should be 0.
# - reg: Physical base address and length of the registers of the PHY sub blocks.
# - reg-names: The names of register regions. The following regions are required:
#   * "hdmi_phy"
#   * "hdmi_pll"
#   For HDMI PHY on msm8996, these additional register regions are required:
#     * "hdmi_tx_l0"
#     * "hdmi_tx_l1"
#     * "hdmi_tx_l3"
#     * "hdmi_tx_l4"
# - power-domains: Should be <&mmcc MDSS_GDSC>.
# - clocks: device clocks
#   See Documentation/devicetree/bindings/clock/clock-bindings.txt for details.
# - core-vdda-supply: phandle to vdda regulator device node

examples:
  - |
    hdmi: hdmi@4a00000 {
      compatible = "qcom,hdmi-tx-8960";
      reg-names = "core_physical";
      reg = <0x04a00000 0x2f0>;
      interrupts = <GIC_SPI 79 0>;
      power-domains = <&mmcc MDSS_GDSC>;
      clock-names =
          "core",
          "master_iface",
          "slave_iface";
      clocks =
          <&mmcc HDMI_APP_CLK>,
          <&mmcc HDMI_M_AHB_CLK>,
          <&mmcc HDMI_S_AHB_CLK>;
      qcom,hdmi-tx-ddc-clk = <&msmgpio 70 GPIO_ACTIVE_HIGH>;
      qcom,hdmi-tx-ddc-data = <&msmgpio 71 GPIO_ACTIVE_HIGH>;
      qcom,hdmi-tx-hpd = <&msmgpio 72 GPIO_ACTIVE_HIGH>;
      core-vdda-supply = <&pm8921_hdmi_mvs>;
      hdmi-mux-supply = <&ext_3p3v>;
      pinctrl-names = "default", "sleep";
      pinctrl-0 = <&hpd_active  &ddc_active  &cec_active>;
      pinctrl-1 = <&hpd_suspend &ddc_suspend &cec_suspend>;

      phys = <&hdmi_phy>;
      phy-names = "hdmi_phy";
    };

    hdmi_phy: phy@4a00400 {
      compatible = "qcom,hdmi-phy-8960";
      reg-names = "hdmi_phy",
                  "hdmi_pll";
      reg = <0x4a00400 0x60>,
            <0x4a00500 0x100>;
      #phy-cells = <0>;
      power-domains = <&mmcc MDSS_GDSC>;
      clock-names = "slave_iface";
      clocks = <&mmcc HDMI_S_AHB_CLK>;
      core-vdda-supply = <&pm8921_hdmi_mvs>;
    };
```

## Documentation/devicetree/bindings/iommu/msm,iommu-v0.yaml
```yaml
# SPDX-License-Identifier: (GPL-2.0-only OR BSD-2-Clause)
%YAML 1.2
---

$id: "http://devicetree.org/schemas/iommu/msm,iommu-v0.yaml#"
$schema: "http://devicetree.org/meta-schemas/core.yaml#"

title: QCOM IOMMU for APQ8064

maintainers:
  - Will Deacon <will@kernel.org>

description: |
  The MSM IOMMU is an implementation compatible with the ARM VMSA short
  descriptor page tables. It provides address translation for bus masters outside
  of the CPU, each connected to the IOMMU through a port called micro-TLB.

properties:
  compatible:
    const: qcom,apq8064-iommu

  clocks:
    items:
      - description: interface clock for register accesses
      - description: functional clock for bus accesses

  clock-names:
    oneOf:
      - items:
          - const: smmu_pclk
          - const: smmu_clk
      - items:
          - const: smmu_pclk
          - const: iommu_clk
  reg:
    maxItems: 1

  interrupts:
    description: |
      Specifiers for the MMU fault interrupts. For instances that
      support secure mode two interrupts must be specified, for non-secure and
      secure mode, in that order. For instances that don't support secure mode a
      single interrupt must be specified.

  iommus:
    description: |
      A reference to the IOMMU in multiple cells. The first cell is a
      phandle to the IOMMU and the second cell is the stream id.
      A single master device can be connected to more than one iommu
      and multiple contexts in each of the iommu. So multiple entries
      are required to list all the iommus and the stream ids that the
      master is connected to.

  "#iommu-cells":
    const: 1
    description: |
      The number of cells needed to specify the stream id.

  qcom,ncb:
    $ref: /schemas/types.yaml#/definitions/uint32
    description: The total number of context banks in the IOMMU.

required:
  - clocks
  - clock-names
  - reg
  - interrupts
  - qcom,ncb

additionalProperties: false

examples:
  - |
    #include <dt-bindings/clock/qcom,mmcc-msm8960.h>

    mdp_port0: iommu@7500000 {
            compatible = "qcom,apq8064-iommu";
            #iommu-cells = <1>;
            clock-names =
                "smmu_pclk",
                "smmu_clk";
            clocks =
                <&mmcc SMMU_AHB_CLK>,
                <&mmcc MDP_AXI_CLK>;
            reg = <0x07500000 0x100000>;
            interrupts =
                <GIC_SPI 63 0>,
                <GIC_SPI 64 0>;
            qcom,ncb = <2>;
    };

    mdp: qcom,mdp@5100000 {
            compatible = "qcom,mdp";
            ...
            iommus = <&mdp_port0 0
                      &mdp_port0 2>;
    };
```

## Documentation/devicetree/bindings/phy/qcom,usb-hs-phy.yaml
```yaml
# SPDX-License-Identifier: (GPL-2.0-only OR BSD-2-Clause)
%YAML 1.2
---
$id: http://devicetree.org/schemas/phy/qcom,usb-hs-phy.yaml#
$schema: http://devicetree.org/meta-schemas/core.yaml#

title: Qualcomm's USB HS PHY binding description

maintainers:
  - Bjorn Andersson <bjorn.andersson@linaro.org>

properties:
  compatible:
    items:
      - enum:
          - qcom,usb-hs-phy-apq8064
          - qcom,usb-hs-phy-msm8916
          - qcom,usb-hs-phy-msm8974
      - const: qcom,usb-hs-phy

  clocks: true

  clock-names:
    oneOf:
      - items:
          - const: ref
          - const: sleep
      - items:
          - const: sleep
          - const: ref

  resets: true

  reset-names:
    oneOf:
      - items:
          - const: por
      - items:
          - const: phy
          - const: por

  "#phy-cells":
    const: 0

  v3p3-supply: true
  v1p8-supply: true
  extcon: true

  qcom,init-seq:
    $ref: /schemas/types.yaml#/definitions/uint8-array
    description: |
      Should contain a sequence of ULPI address and value pairs to
      program into the ULPI_EXT_VENDOR_SPECIFIC area. This is related
      to Device Mode Eye Diagram test. The addresses are offsets
      from the ULPI_EXT_VENDOR_SPECIFIC address, for example,
      <0x1 0x53> would mean "write the value 0x53 to address 0x81".

required:
  - clocks
  - clock-names
  - resets
  - reset-names
  - "#phy-cells"

additionalProperties: false

examples:
  - |
    #include <dt-bindings/clock/qcom,gcc-msm8974.h>
    otg: usb-controller {
      ulpi {
        phy {
          compatible = "qcom,usb-hs-phy-msm8974", "qcom,usb-hs-phy";
          #phy-cells = <0>;
          clocks = <&xo_board>, <&gcc GCC_USB2A_PHY_SLEEP_CLK>;
          clock-names = "ref", "sleep";
          resets = <&gcc GCC_USB2A_PHY_BCR>, <&otg 0>;
          reset-names = "phy", "por";
          v3p3-supply = <&pm8941_l24>;
          v1p8-supply = <&pm8941_l6>;
          extcon = <&smbb>;
          qcom,init-seq = /bits/ 8 <0x1 0x63>;
        };
      };
    };
```
